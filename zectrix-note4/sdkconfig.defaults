## zectrix-note4/sdkconfig.defaults
```kconfig
# --- Board ---
CONFIG_IDF_TARGET="esp32s3"

# --- Flash + PSRAM (Note 4 = 16MB flash, 8MB PSRAM) ---
CONFIG_ESPTOOLPY_FLASHSIZE="16MB"
CONFIG_ESPTOOLPY_FLASHSIZE_16MB=y
CONFIG_SPIRAM=y
CONFIG_SPIRAM_MODE_OCT=y
CONFIG_SPIRAM_SPEED_80M=y

# --- Partitions ---
CONFIG_PARTITION_TABLE_CUSTOM=y
CONFIG_PARTITION_TABLE_CUSTOM_FILENAME="partitions.csv"
CONFIG_PARTITION_TABLE_OFFSET=0x8000

# --- BLE (NimBLE, no classic BT) ---
CONFIG_BT_ENABLED=y
CONFIG_BT_NIMBLE_ENABLED=y
CONFIG_BT_CONTROLLER_ENABLED=y
CONFIG_BT_CONTROLLER_ONLY=n
CONFIG_BT_BLUEDROID_ENABLED=n
CONFIG_BT_NIMBLE_ROLE_PERIPHERAL=y
CONFIG_BT_NIMBLE_SM_LEGACY=y
CONFIG_BT_NIMBLE_SM_SC=y

# --- FreeRTOS tick = 1000 Hz so millis-style timing is clean ---
CONFIG_FREERTOS_HZ=1000

# --- Main task stack (our JSON + framebuffer work uses it) ---
CONFIG_ESP_MAIN_TASK_STACK_SIZE=8192

# --- Log level at runtime (info, not debug) ---
CONFIG_LOG_DEFAULT_LEVEL_INFO=y

# --- Console: route ESP_LOGI / printf through the built-in USB Serial JTAG
# peripheral, which is what the Note 4's USB-C physically talks to. Without
# this, console goes to UART0 physical pins that aren't wired to the
# connector, and `pio device monitor` sees nothing. ---
CONFIG_ESP_CONSOLE_USB_SERIAL_JTAG=y
CONFIG_ESP_CONSOLE_SECONDARY_NONE=y
# Reboot on double-tap RESET to help recover if USB goes dead
CONFIG_ESP_SYSTEM_PANIC_PRINT_HALT=y
```
